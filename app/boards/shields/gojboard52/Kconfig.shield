## app/boards/shields/gojboard52/Kconfig.shield
```kconfig
# Copyright (c) 2020 Pete Johanson
# SPDX-License-Identifier: MIT

config SHIELD_GOJBOARD52_LEFT
	def_bool $(shields_list_contains,gojboard52_left)

config SHIELD_GOJBOARD52_RIGHT
	def_bool $(shields_list_contains,gojboard52_right)
```

## app/boards/shields/gojiboard52_touch/Kconfig.shield
```kconfig
# Copyright (c) 2020 Pete Johanson
# SPDX-License-Identifier: MIT

config SHIELD_gojiboard52_LEFT
    def_bool $(shields_list_contains,gojiboard52_left)

config SHIELD_gojiboard52_RIGHT
    def_bool $(shields_list_contains,gojiboard52_right)
```

## app/module/drivers/sensor/Kconfig
```kconfig
# Copyright (c) 2020 The ZMK Contributors
# SPDX-License-Identifier: MIT

if SENSOR

rsource "battery/Kconfig"
rsource "ec11/Kconfig"
rsource "max17048/Kconfig"
rsource "at42qt2120/Kconfig"

endif # SENSOR
```
